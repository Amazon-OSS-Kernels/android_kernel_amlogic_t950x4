## bootable/bootloader/uboot-amlogic/t950x4/bl33/board/amlogic/defconfigs/primrose_defconfig
```kconfig
CONFIG_ARM=y
CONFIG_TARGET_MESON_TM2=y
CONFIG_PRIMROSE=y
CONFIG_DM=y
CONFIG_DM_GPIO=y
CONFIG_AML_GPIO=y
CONFIG_MTK_BT_USB=y
```

## bootable/bootloader/uboot-amlogic/t950x4/bl33/board/amlogic/defconfigs/shine_defconfig
```kconfig
CONFIG_ARM=y
CONFIG_TARGET_MESON_T5D=y
CONFIG_SHINE=y
CONFIG_DM=y
CONFIG_DM_GPIO=y
CONFIG_AML_GPIO=y
CONFIG_MTK_BT_USB=y
CONFIG_TEE=y
CONFIG_OPTEE=y
```

## kernel/amlogic/t950x4/4.9/Documentation/devicetree/bindings/amlogic/ledstate.txt
```
Amlogic Meson LED
============================

Required properties:
	-for t5d
		amlogic,state-led-aocpu
```

## kernel/amlogic/t950x4/4.9/Documentation/devicetree/bindings/perf/amlogic-ddr-pmu.yaml
```yaml
# SPDX-License-Identifier: (GPL-2.0-only OR BSD-2-Clause)
%YAML 1.2
---
$id: http://devicetree.org/schemas/perf/amlogic-ddr-pmu.yaml#
$schema: http://devicetree.org/meta-schemas/core.yaml#

title: Amlogic DMC Performance Monitor Unit

maintainers:
  - Jiucheng Xu <jiucheng.xu@amlogic.com>

description:
  This driver is used to measure DDR bandwidth, it can measure total
  bandwidth of DDR, also can configure port in each channel and get
  detailed bandwidth for each channel.

properties:
  compatible:
    oneOf:
      - enum:
          - amlogic,ddr-pmu
      - items:
          - enum:
              - amlogic,ddr-pmu
          - const: amlogic,ddr-pmu

  reg:
    maxItems: 1

  interrupts:
    maxItems: 1

  interrupt-names:
    maxItems: 1

required:
  - compatible
  - reg
  - interrupts
  - interrupt-names

additionalProperties: false

examples:
  - |
    ddr_pmu0 {
        compatible = "amlogic,ddr-pmu";
        reg = <0 0xfe036000 0 0x400
               0 0xfe0a0000 0 0x100>;
        interrupts = <0 332 IRQ_TYPE_EDGE_RISING>;
        interrupt-names = "ddr_pmu0";
    };
```

## kernel/amlogic/t950x4/4.9/Documentation/devicetree/bindings/sound/acm8625.txt
```
Texas Instruments ACM8625 Audio amplifier

The ACM8625 serial control bus communicates through the I2C protocol only. The
serial bus is also used for periodic codec fault checking/reporting during
audio playback. For more product information please see the links below:

Required properties:

- compatible : "acme, acm8625"
- reg : I2C slave address

Example:

acm8625: acm8625@7c {
        status = "okay";
        compatible = "acme,acm8625";
        reg = <0x2d>;
};
```
