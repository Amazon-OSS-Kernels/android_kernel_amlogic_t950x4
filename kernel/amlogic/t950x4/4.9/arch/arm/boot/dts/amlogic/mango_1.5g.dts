/*
 * arch/arm/boot/dts/amlogic/t5d_t950d4_am301_1.5g.dts
 *
 * Copyright (C) 2017 Amlogic, Inc. All rights reserved.
 *
 * This program is free software; you can redistribute it and/or modify
 * it under the terms of the GNU General Public License as published by
 * the Free Software Foundation; either version 2 of the License, or
 * (at your option) any later version.
 *
 * This program is distributed in the hope that it will be useful, but WITHOUT
 * ANY WARRANTY; without even the implied warranty of MERCHANTABILITY or
 * FITNESS FOR A PARTICULAR PURPOSE.  See the GNU General Public License for
 * more details.
 *
 */

/dts-v1/;

#include "almond_1.5g.dts"

/ {
	model = "Amlogic T5D T950D4 Mango 1.5G";
	amlogic-dt-id = "t5d_t950d4_mango-1.5g";
	compatible = "amlogic, t5d_t950d4_mango_1.5g";

};

&usb2_phy_v2 {
	pll-setting-4 = <0x7e18>;
};

